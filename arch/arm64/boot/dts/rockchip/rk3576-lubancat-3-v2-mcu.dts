// SPDX-License-Identifier: (GPL-2.0+ OR MIT)
/*
 * Copyright (c) 2024 Rockchip Electronics Co., Ltd.
 * Copyright (c) 2026 EmbedFire <embedfire@embedfire.com>
 *
 * LubanCat-3 v2 AMP variant: Linux + Cortex-M0 (bus_mcu) RT-Thread.
 * Adds the AMP reserved-memory regions and the rockchip,amp node on top of the
 * stock v2 board, so the M0 firmware window (0x60000000) and the Linux<->RTOS
 * shared memory stay reserved.
 */

/dts-v1/;

#include "rk3576-lubancat-3-v2.dts"
#include "rk3576-amp.dtsi"
#include "rk3576-lubancat-3-headless.dtsi"

/ {
	model = "EmbedFire LubanCat-3-v2 (AMP / Cortex-M0 RT-Thread)";
};
